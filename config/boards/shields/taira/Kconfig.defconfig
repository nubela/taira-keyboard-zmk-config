## config/boards/shields/taira/Kconfig.defconfig
```kconfig
# Copyright (c) 2020 The ZMK Contributors
# SPDX-License-Identifier: MIT

if SHIELD_TAIRA_RIGHT

config ZMK_KEYBOARD_NAME
	default "Nubela KB Right"

endif

if SHIELD_TAIRA_LEFT

config ZMK_KEYBOARD_NAME
	default "Nubela KB Left"

endif
```
